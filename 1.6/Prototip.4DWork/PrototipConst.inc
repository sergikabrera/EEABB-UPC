// File generated 18/06/2021 14:12:53
// Warning! This is a generated file, any manual changes will be
// lost during the next generation.

#constant  Strings8Count    0
#constant  Strings8Size     1
#constant  Strings10Count    0
#constant  Strings10Size     1
#constant  Strings0Count    0
#constant  Strings0Size     1
#constant  Strings1Count    0
#constant  Strings1Size     1
#constant  Strings7Count    0
#constant  Strings7Size     1
#constant  Strings4Count    0
#constant  Strings4Size     1
#constant  Strings5Count    0
#constant  Strings5Size     1
#constant  Strings6Count    0
#constant  Strings6Size     1
#constant  Strings2Count    0
#constant  Strings2Size     1
#constant  Strings3Count    0
#constant  Strings3Size     1
#constant  IFONT_OFFSET     0
// object indexes into ImageControl
#CONST
    iWinbutton0     // offset 0x0
    iStatictext4    // offset 0xC400
    iWinbutton7     // offset 0x12600
    iWinbutton8     // offset 0x17000
    iStatictext13   // offset 0x1BA00
    iStatictext14   // offset 0x1D600
    iWinbutton18    // offset 0x20600
    iLeddigits31    // offset 0x25000
    iiLeddigits31   // offset 0x26200
    iLeddigits32    // offset 0x2B600
    iiLeddigits32   // offset 0x2C800
    iLeddigits33    // offset 0x31C00
    iiLeddigits33   // offset 0x32E00
    iWinbutton1     // offset 0x38200
    iWinbutton2     // offset 0x40600
    iWinbutton3     // offset 0x44800
    iWinbutton4     // offset 0x48A00
    iWinbutton13    // offset 0x4CC00
    iWinbutton45    // offset 0x50E00
    iStatictext0    // offset 0x55000
    iLeddigits37    // offset 0x55600
    iiLeddigits37   // offset 0x56800
    iLeddigits38    // offset 0x5BC00
    iiLeddigits38   // offset 0x5CE00
    iLeddigits39    // offset 0x62200
    iiLeddigits39   // offset 0x63400
    iLeddigits8     // offset 0x68800
    iiLeddigits8    // offset 0x6AA00
    iLeddigits9     // offset 0x6FE00
    iiLeddigits9    // offset 0x72000
    iLeddigits10    // offset 0x77400
    iiLeddigits10   // offset 0x79600
    iLeddigits11    // offset 0x7EA00
    iiLeddigits11   // offset 0x80C00
    iWinbutton11    // offset 0x86000
    iStatictext30   // offset 0x8A200
    iStatictext31   // offset 0x8B400
    iLeddigits12    // offset 0x8C400
    iiLeddigits12   // offset 0x8E600
    iStatictext32   // offset 0x93A00
    iStatictext28   // offset 0x94000
    iStatictext29   // offset 0x95200
    iStatictext34   // offset 0x95A00
    iStatictext35   // offset 0x96600
    iStatictext36   // offset 0x96E00
    iLeddigits34    // offset 0x97A00
    iiLeddigits34   // offset 0x98600
    iLeddigits35    // offset 0x9BC00
    iiLeddigits35   // offset 0x9C800
    iLeddigits36    // offset 0x9FE00
    iiLeddigits36   // offset 0xA0A00
    iStatictext79   // offset 0xA4000
    iWinbutton48    // offset 0xA4400
    iWinbutton49    // offset 0xA9000
    iWinbutton5     // offset 0xAD200
    iStatictext3    // offset 0xB1400
    iLeddigits0     // offset 0xB4A00
    iiLeddigits0    // offset 0xB6C00
    iLeddigits1     // offset 0xBC000
    iiLeddigits1    // offset 0xBE200
    iStatictext17   // offset 0xC3600
    iStatictext18   // offset 0xC4800
    iStatictext19   // offset 0xC5200
    iLeddigits7     // offset 0xC5C00
    iiLeddigits7    // offset 0xC7E00
    iStatictext27   // offset 0xCD200
    iStatictext16   // offset 0xCE000
    iWinbutton12    // offset 0xD1200
    iLeddigits4     // offset 0xD5400
    iiLeddigits4    // offset 0xD7600
    iLeddigits5     // offset 0xDCA00
    iiLeddigits5    // offset 0xDEC00
    iLeddigits6     // offset 0xE4000
    iiLeddigits6    // offset 0xE6200
    iStatictext20   // offset 0xEB600
    iStatictext21   // offset 0xEC000
    iStatictext22   // offset 0xED200
    iStatictext23   // offset 0xEDA00
    iLeddigits2     // offset 0xEEE00
    iiLeddigits2    // offset 0xF1000
    iLeddigits3     // offset 0xF6400
    iiLeddigits3    // offset 0xF8600
    iWinbutton6     // offset 0xFDA00
    iStatictext15   // offset 0x101C00
    iStatictext24   // offset 0x103200
    iStatictext25   // offset 0x103E00
    iStatictext26   // offset 0x104400
    iStatictext5    // offset 0x104E00
    iStatictext7    // offset 0x10DA00
    iWinbutton9     // offset 0x10FE00
    iStatictext6    // offset 0x114000
    iStatictext8    // offset 0x119A00
    iStatictext9    // offset 0x11F000
    iWinbutton50    // offset 0x124E00
    iStatictext10   // offset 0x129000
    iStatictext11   // offset 0x131400
    iStatictext12   // offset 0x139800
    iWinbutton10    // offset 0x147200
    iStatictext37   // offset 0x14B400
    iStatictext38   // offset 0x14C400
    iStatictext39   // offset 0x154600
    iStatictext40   // offset 0x156600
    iStatictext41   // offset 0x158800
    iWinbutton14    // offset 0x159E00
    iWinbutton15    // offset 0x15E000
    iWinbutton16    // offset 0x162200
    iWinbutton17    // offset 0x166400
    iUserled0       // offset 0x16A600
    iUserled1       // offset 0x16B200
    iUserled2       // offset 0x16BE00
    iStatictext78   // offset 0x16CA00
    iStatictext42   // offset 0x16D200
    iStatictext43   // offset 0x16DE00
    iStatictext44   // offset 0x178A00
    iStatictext45   // offset 0x17A000
    iStatictext46   // offset 0x17D600
    iStatictext47   // offset 0x17FC00
    iImage0         // offset 0x182C00
    iWinbutton19    // offset 0x18A600
    iWinbutton20    // offset 0x18E800
    iStatictext48   // offset 0x192A00
    iWinbutton21    // offset 0x194200
    iWinbutton22    // offset 0x198400
    iStatictext49   // offset 0x19C600
    iStatictext50   // offset 0x1A4600
    iStatictext51   // offset 0x1A7C00
    iImage1         // offset 0x1AB000
    iStatictext52   // offset 0x1B2A00
    iWinbutton23    // offset 0x1B4000
    iWinbutton24    // offset 0x1B8200
    iStatictext53   // offset 0x1BC400
    iStatictext54   // offset 0x1C4A00
    iImage2         // offset 0x1C7800
    iStatictext55   // offset 0x1CE200
    iWinbutton26    // offset 0x1D2800
    iWinbutton27    // offset 0x1D6A00
    iLeddigits13    // offset 0x1D8600
    iiLeddigits13   // offset 0x1D9C00
    iWinbutton28    // offset 0x1E0E00
    iStatictext56   // offset 0x1E2A00
    iStatictext57   // offset 0x1E3000
    iLeddigits14    // offset 0x1E3800
    iiLeddigits14   // offset 0x1E4E00
    iWinbutton29    // offset 0x1EC000
    iWinbutton30    // offset 0x1EDC00
    iStatictext58   // offset 0x1EF800
    iLeddigits15    // offset 0x1F0000
    iiLeddigits15   // offset 0x1F1600
    iWinbutton31    // offset 0x1F8800
    iWinbutton32    // offset 0x1FA400
    iLeddigits16    // offset 0x1FC000
    iiLeddigits16   // offset 0x1FD000
    iLeddigits17    // offset 0x201800
    iiLeddigits17   // offset 0x202800
    iLeddigits18    // offset 0x207000
    iiLeddigits18   // offset 0x208000
    iStatictext59   // offset 0x20C800
    iStatictext60   // offset 0x20D200
    iStatictext61   // offset 0x20D600
    iStatictext62   // offset 0x20DA00
    iWinbutton33    // offset 0x20E000
    iWinbutton46    // offset 0x212200
    iStatictext63   // offset 0x216400
    iWinbutton34    // offset 0x21C000
    iStatictext64   // offset 0x220200
    iLeddigits19    // offset 0x220600
    iiLeddigits19   // offset 0x221C00
    iWinbutton35    // offset 0x228E00
    iWinbutton36    // offset 0x22AA00
    iStatictext65   // offset 0x22C600
    iLeddigits20    // offset 0x22CC00
    iiLeddigits20   // offset 0x22E200
    iWinbutton37    // offset 0x235400
    iWinbutton38    // offset 0x237000
    iStatictext66   // offset 0x238C00
    iLeddigits21    // offset 0x239200
    iiLeddigits21   // offset 0x23BC00
    iWinbutton39    // offset 0x242200
    iWinbutton40    // offset 0x243E00
    iStatictext67   // offset 0x245A00
    iLeddigits22    // offset 0x246400
    iiLeddigits22   // offset 0x247400
    iLeddigits23    // offset 0x24BC00
    iiLeddigits23   // offset 0x24CC00
    iLeddigits24    // offset 0x251400
    iiLeddigits24   // offset 0x252400
    iStatictext68   // offset 0x254A00
    iStatictext69   // offset 0x254C00
    iStatictext70   // offset 0x255000
    iWinbutton41    // offset 0x255400
    iWinbutton47    // offset 0x259600
    iStatictext71   // offset 0x25D800
    iWinbutton42    // offset 0x261400
    iLeddigits25    // offset 0x265600
    iiLeddigits25   // offset 0x267000
    iStatictext72   // offset 0x26F000
    iStatictext73   // offset 0x26F600
    iLeddigits26    // offset 0x26FC00
    iiLeddigits26   // offset 0x271600
    iStatictext74   // offset 0x279600
    iLeddigits27    // offset 0x279E00
    iiLeddigits27   // offset 0x27B800
    iStatictext75   // offset 0x283800
    iLeddigits28    // offset 0x283C00
    iiLeddigits28   // offset 0x285600
    iStatictext76   // offset 0x28D600
    iLeddigits29    // offset 0x28DA00
    iiLeddigits29   // offset 0x28F400
    iStatictext77   // offset 0x297400
    iLeddigits30    // offset 0x297800
    iiLeddigits30   // offset 0x29AC00
    iWinbutton43    // offset 0x2A2C00
    iWinbutton44    // offset 0x2A6E00
    iStatictext33   // offset 0x2AB000
    iStatictext80   // offset 0x2ACC00
    iStatictext81   // offset 0x2B2A00
    iStatictext82   // offset 0x2B8000
    iWinbutton51    // offset 0x2BF800
    iWinbutton52    // offset 0x2C3A00
#END

#constant  Strings9Size     0
#constant  Strings9StartH   0
#constant  Strings9StartL   0

#constant  Strings8StartH   0x0
#constant  Strings8StartL   0x0
#constant  Strings10StartH   0x0
#constant  Strings10StartL   0x200
#constant  Strings0StartH   0x0
#constant  Strings0StartL   0x400
#constant  Strings1StartH   0x0
#constant  Strings1StartL   0x600
#constant  Strings7StartH   0x0
#constant  Strings7StartL   0x800
#constant  Strings4StartH   0x0
#constant  Strings4StartL   0xA00
#constant  Strings5StartH   0x0
#constant  Strings5StartL   0xC00
#constant  Strings6StartH   0x0
#constant  Strings6StartL   0xE00
#constant  Strings2StartH   0x0
#constant  Strings2StartL   0x1000
#constant  Strings3StartH   0x0
#constant  Strings3StartL   0x1200

#IFNOT EXISTS NOGLOBALS
var hndl ;
var hFonts[11] ;
#ENDIF
